;------------------------------------------------------------------------
;                                                                       |
;                                                                       |
;                                                                       |
;   DESCRIPTION :define the sfr register. (for Assembler language)      |
;                                                                       |
;                                                                       |
;   This file is generated by Renesas Project Generator.                |
;                                                                       |
;------------------------------------------------------------------------
;/***********************************************************************
;*
;* Device       : R8C/24,25
;*
;* File Name    : sfr_r825.inc
;*
;* Abstract     : Define the sfr register.
;*
;* History      : 1.40 (06-06-08)
;*              : 1.30 (05-11-30)
;*              : 1.20 (05-10-04)
;*              : 1.10 (05-08-08)
;*              : 1.00 (05-08-01)
;*
;* NOTE         : THIS IS A TYPICAL EXAMPLE.
;*
;* Copyright (C) 2005 (2006) Renesas Electronics Corporation.
;* and Renesas Solutions Corp.
;*
;************************************************************************/
;
;-------------------------------------------------------
;   Processor mode register0
;-------------------------------------------------------
pm0				.equ		0004h
;
pm03			.btequ		3,pm0		; Software reset bit
;
;-------------------------------------------------------
;   Processor mode register1
;-------------------------------------------------------
pm1				.equ		0005h
;
pm12			.btequ		2,pm1		; WDT interrupt/reset select bit
;
;-------------------------------------------------------
;   System clock control register0
;-------------------------------------------------------
cm0				.equ		0006h
;
cm02			.btequ		2,cm0		; WAIT peripheral function clock stop bit
cm03			.btequ		3,cm0		; XCIN-XCOUT drive capacity select bit
cm04			.btequ		4,cm0		; Port XC switch bit
cm05			.btequ		5,cm0		; Xin clock (Xin-Xout) stop bit
cm06			.btequ		6,cm0		; System clock division select bit0
cm07			.btequ		7,cm0		; CPU clock select bit
;
;-------------------------------------------------------
;   System clock control register1
;-------------------------------------------------------
cm1				.equ		0007h
;	
cm10			.btequ		0,cm1		; All clock stop control bit
cm11			.btequ		1,cm1		; XIN-XOUT internal resistor select bit
cm12			.btequ		2,cm1		; XCIN-XCOUT internal resistor select bit
cm13			.btequ		3,cm1		; Port Xin-Xout switch bit
cm14			.btequ		4,cm1		; Low-speed on-chip oscillator stop bit
cm15			.btequ		5,cm1		; Xin-Xout drive capability select bit
cm16			.btequ		6,cm1		; System clock division select bit1
cm17			.btequ		7,cm1		;
;
;-------------------------------------------------------
;   Protect register
;-------------------------------------------------------
prcr			.equ		000ah
;
prc0			.btequ		0,prcr		; Protect bit0
prc1			.btequ		1,prcr		; Protect bit1
prc2			.btequ		2,prcr		; Protect bit2
prc3			.btequ		3,prcr		; Protect bit3
;
;-------------------------------------------------------
;   Oscillation stop detection register
;-------------------------------------------------------
ocd				.equ		000ch
;
ocd0			.btequ		0,ocd		; Oscillation stop detection enable bit
ocd1			.btequ		1,ocd		; Oscillation stop detection interrupt enable bit
ocd2			.btequ		2,ocd		; System clock select bit
ocd3			.btequ		3,ocd		; Clock monitor bit
;
;-------------------------------------------------------
;   Watchdog timer
;-------------------------------------------------------
wdtr			.equ		000dh		; Watchdog timer reset register
;
wdts			.equ		000eh		; Watchdog timer start register
;
wdc				.equ		000fh		; Watchdog timer control register
;
wdc7			.btequ		7,wdc		; Prescaler select bit
;
;-------------------------------------------------------
;   Address match interrupt register0
;-------------------------------------------------------
rmad0			.equ		0010h
rmad0l			.equ		rmad0		; Address match interrupt register0 Low
rmad0m			.equ		rmad0+1		; Address match interrupt register0 Middle
rmad0h			.equ		rmad0+2		; Address match interrupt register0 High
;

;-------------------------------------------------------
;   Address match interrupt enable register
;-------------------------------------------------------
aier			.equ		0013h
;
aier0			.btequ		0,aier		; Address match interrupt 0 enable bit
aier1			.btequ		1,aier		; Address match interrupt 1 enable bit
;

;-------------------------------------------------------
;   Address match interrupt register1
;-------------------------------------------------------
rmad1			.equ		0014h
rmad1l			.equ		rmad1		; Address match interrupt register1 Low
rmad1m			.equ		rmad1+1		; Address match interrupt register1 Middle
rmad1h			.equ		rmad1+2		; Address match interrupt register1 High
;
;-------------------------------------------------------
;   Count source protect mode register
;-------------------------------------------------------
cspr			.equ		001ch
;
cspro			.btequ		7,cspr		; WDT count source protect mode select bit
;
;-------------------------------------------------------
;   High-speed on-chip oscillator control register0
;-------------------------------------------------------
fra0			.equ		0023h
;
fra00			.btequ		0,fra0		; High-speed on-chip oscillator enable bit
fra01			.btequ		1,fra0		; High-speed on-chip oscillator select bit
;
;-------------------------------------------------------
;   High-speed on-chip oscillator control register1
;-------------------------------------------------------
fra1			.equ		0024h
;
;-------------------------------------------------------
;   High-speed on-chip oscillator control register2
;-------------------------------------------------------
fra2			.equ		0025h
;
fra20			.btequ		0,fra2		; High-speed on-chip oscillator frequency switching bit
fra21			.btequ		1,fra2		; High-speed on-chip oscillator frequency switching bit
fra22			.btequ		2,fra2		; High-speed on-chip oscillator frequency switching bit
;
;-------------------------------------------------------
;	Clock prescaler reset flag
;-------------------------------------------------------
cpsrf			.equ		0028h
;
cpsr			.btequ		7,cpsrf		; Clock prescaler reset flag
;
;-------------------------------------------------------
;  High-speed on-chip oscillator control register 4
;-------------------------------------------------------
fra4			.equ		0029h

;-------------------------------------------------------
;  High-speed on-chip oscillator control register 6
;-------------------------------------------------------
fra6			.equ		002Bh
;
;-------------------------------------------------------
;   Voltage detection register1
;-------------------------------------------------------
vca1			.equ		0031h
;
vca13			.btequ		3,vca1		; Voltage detection 2 signal monitor flag
;
;-------------------------------------------------------
;   Voltage detection register2
;-------------------------------------------------------
vca2			.equ		0032h
;
vca20			.btequ		0,vca2		; Internal power low consumption enable bit
vca25			.btequ		5,vca2		; Voltage detection 0 enable bit
vca26			.btequ		6,vca2		; Voltage detection 1 enable bit
vca27			.btequ		7,vca2		; Voltage detection 2 enable bit
;
;-------------------------------------------------------
;   Voltage monitor 1 circuit control register
;-------------------------------------------------------
vw1c			.equ		0036h
;
vw1c0			.btequ		0,vw1c		; Voltage monitor 1 interrupt / reset enable bit
vw1c1			.btequ		1,vw1c		; Voltage Monitor 1 digital filter disable mode select bit
vw1c2			.btequ		2,vw1c		; Voltage change detection flag
vw1c3			.btequ		3,vw1c		; Voltage detection 1 signal monitor flag
vw1f0			.btequ		4,vw1c		; Sampling clock select bit
vw1f1			.btequ		5,vw1c		; Sampling clock select bit
vw1c6			.btequ		6,vw1c		; Voltage monitor 1 circuit mode select bit
vw1c7			.btequ		7,vw1c		; Voltage monitor 1 interrupt / reset generating condition select bit
;
;-------------------------------------------------------
;   Voltage monitor 2 circuit control register
;-------------------------------------------------------
vw2c			.equ		0037h

vw2c0			.btequ		0,vw2c		; Voltage monitor 2 interrupt / reset enable bit
vw2c1			.btequ		1,vw2c		; Voltage monitor 2 digital filter disabled mode select bit
vw2c2			.btequ		2,vw2c		; Voltage change detection flag
vw2c3			.btequ		3,vw2c		; WDT Detection Flag
vw2f0			.btequ		4,vw2c		; Sampling clock select bit
vw2f1			.btequ		5,vw2c		; Sampling clock select bit
vw2c6			.btequ		6,vw2c		; Voltage monitor 2 circuit mode select bit
vw2c7			.btequ		7,vw2c		; Voltage monitor 2 interrupt / reset generating condition select bit
;                                     
;-------------------------------------------------------
;   Voltage monitor 0 circuit control register
;-------------------------------------------------------
vw0c			.equ		0038h

vw0c0			.btequ		0,vw0c		; Voltage monitor 0 reset enable bit
vw0c1			.btequ		1,vw0c		; Voltage Monitor 0 digital filter disable mode select bit
vw0c2			.btequ		2,vw0c		;
vw0f0			.btequ		4,vw0c		; Sampling clock select bit
vw0f1			.btequ		5,vw0c		; Sampling clock select bit
vw0c6			.btequ		6,vw0c		; Voltage monitor 0 circuit mode select bit
vw0c7			.btequ		7,vw0c		; Voltage monitor 0 reset generating condition select bit
;
;-------------------------------------------------------
;   Interrupt control registers
;-------------------------------------------------------
trd0ic			.equ		0048h		; Timer RD0 interrupt control register
ilvl0_trd0ic	.btequ		0,trd0ic	; Interrupt priority level select bit
ilvl1_trd0ic	.btequ		1,trd0ic	;
ilvl2_trd0ic	.btequ		2,trd0ic	;
ir_trd0ic		.btequ		3,trd0ic	; Interrupt request bit
;
trd1ic			.equ		0049h		; Timer RD1 interrupt control register
ilvl0_trd1ic	.btequ		0,trd1ic	; Interrupt priority level select bit
ilvl1_trd1ic	.btequ		1,trd1ic	;
ilvl2_trd1ic	.btequ		2,trd1ic	;
ir_trd1ic		.btequ		3,trd1ic	; Interrupt request bit
;
treic			.equ		004Ah		; Timer RE interrupt control register
ilvl0_treic		.btequ		0,treic		; Interrupt priority level select bit
ilvl1_treic		.btequ		1,treic		;
ilvl2_treic		.btequ		2,treic		;
ir_treic		.btequ		3,treic		; Interrupt request bit
;
kupic			.equ		004dh		; Key input interrupt control register
ilvl0_kupic		.btequ		0,kupic		; Interrupt priority level select bit
ilvl1_kupic		.btequ		1,kupic		;
ilvl2_kupic		.btequ		2,kupic		;
ir_kupic		.btequ		3,kupic		; Interrupt request bit
;
adic			.equ		004eh		; A-D conversion interrupt control register
ilvl0_adic		.btequ		0,adic		; Interrupt priority level select bit
ilvl1_adic		.btequ		1,adic		;
ilvl2_adic		.btequ		2,adic		;
ir_adic			.btequ		3,adic		; Interrupt request bit
;
ssuic			.equ		004fh		; SSU interrupt control register
ilvl0_ssuic		.btequ		0,ssuic		; Interrupt priority level select bit
ilvl1_ssuic		.btequ		1,ssuic		;
ilvl2_ssuic		.btequ		2,ssuic		;
ir_ssuic		.btequ		3,ssuic		; Interrupt request bit
;
ssuaic			.equ		ssuic		; SSU interrupt control register
ilvl0_ssuaic	.btequ		ilvl0_ssuic	; Interrupt priority level select bit
ilvl1_ssuaic	.btequ		ilvl1_ssuic	;
ilvl2_ssuaic	.btequ		ilvl2_ssuic	;
ir_ssuaic		.btequ		ir_ssuic	; Interrupt request bit
;
iicic			.equ		004fh		; IIC interrupt control register
ilvl0_iicic		.btequ		0,iicic		; Interrupt priority level select bit
ilvl1_iicic		.btequ		1,iicic		;
ilvl2_iicic		.btequ		2,iicic		;
ir_iicic		.btequ		3,iicic		; Interrupt request bit
;
iic2aic			.equ		iicic		; IIC interrupt control register
ilvl0_iic2aic	.btequ		ilvl0_iicic	; Interrupt priority level select bit
ilvl1_iic2aic	.btequ		ilvl1_iicic	;
ilvl2_iic2aic	.btequ		ilvl2_iicic	;
ir_iic2aic		.btequ		ir_iicic	; Interrupt request bit
;
s0tic			.equ		0051h		; UART0 transmit interrupt control register
ilvl0_s0tic		.btequ		0,s0tic		; Interrupt priority level select bit
ilvl1_s0tic		.btequ		1,s0tic		;
ilvl2_s0tic		.btequ		2,s0tic		;
ir_s0tic		.btequ		3,s0tic		; Interrupt request bit
;
s0ric			.equ		0052h		; UART0 receive interrupt control register
ilvl0_s0ric		.btequ		0,s0ric		; Interrupt priority level select bit
ilvl1_s0ric		.btequ		1,s0ric		;
ilvl2_s0ric		.btequ		2,s0ric		;
ir_s0ric		.btequ		3,s0ric		; Interrupt request bit
;
s1tic			.equ		0053h		; UART1 transmit interrupt control register
ilvl0_s1tic		.btequ		0,s1tic		; Interrupt priority level select bit
ilvl1_s1tic		.btequ		1,s1tic		;
ilvl2_s1tic		.btequ		2,s1tic		;
ir_s1tic		.btequ		3,s1tic		; Interrupt request bit
;
s1ric			.equ		0054h		; UART1 receive interrupt control register
ilvl0_s1ric		.btequ		0,s1ric		; Interrupt priority level select bit
ilvl1_s1ric		.btequ		1,s1ric		;
ilvl2_s1ric		.btequ		2,s1ric		;
ir_s1ric		.btequ		3,s1ric		; Interrupt request bit
;
int2ic			.equ		0055h		; INT2 interrupt control register
ilvl0_int2ic	.btequ		0,int2ic	; Interrupt priority level select bit
ilvl1_int2ic	.btequ		1,int2ic	;
ilvl2_int2ic	.btequ		2,int2ic	;
ir_int2ic		.btequ		3,int2ic	; Interrupt request bit
pol_int2ic		.btequ		4,int2ic	; Polarity select bit
;
traic			.equ		0056h		; Timer RA interrupt control register
ilvl0_traic		.btequ		0,traic		; Interrupt priority level select bit
ilvl1_traic		.btequ		1,traic		;
ilvl2_traic		.btequ		2,traic		;
ir_traic		.btequ		3,traic		; Interrupt request bit
;
trbic			.equ		0058h		; Timer RB interrupt control register
ilvl0_trbic		.btequ		0,trbic		; Interrupt priority level select bit
ilvl1_trbic		.btequ		1,trbic		;
ilvl2_trbic		.btequ		2,trbic		;
ir_trbic		.btequ		3,trbic		; Interrupt request bit
;
int1ic			.equ		0059h		; INT1 interrupt control register
ilvl0_int1ic	.btequ		0,int1ic	; Interrupt priority level select bit
ilvl1_int1ic	.btequ		1,int1ic	;
ilvl2_int1ic	.btequ		2,int1ic	;
ir_int1ic		.btequ		3,int1ic	; Interrupt request bit
pol_int1ic		.btequ		4,int1ic	; Polarity select bit
;
int3ic			.equ		005ah		; INT3 interrupt control register
ilvl0_int3ic	.btequ		0,int3ic	; Interrupt priority level select bit
ilvl1_int3ic	.btequ		1,int3ic	;
ilvl2_int3ic	.btequ		2,int3ic	;
ir_int3ic		.btequ		3,int3ic	; Interrupt request bit
pol_int3ic		.btequ		4,int3ic	; Polarity select bit
;
int0ic			.equ		005dh		; INT0 interrupt control register
ilvl0_int0ic	.btequ		0,int0ic	; Interrupt priority level select bit
ilvl1_int0ic	.btequ		1,int0ic	;
ilvl2_int0ic	.btequ		2,int0ic	;
ir_int0ic		.btequ		3,int0ic	; Interrupt request bit
pol_int0ic		.btequ		4,int0ic	; Polarity select bit
;
;-------------------------------------------------------
;   UART0
;-------------------------------------------------------
u0mr			.equ		00a0h		; UART0 transmit/receive mode register
smd0_u0mr		.btequ		0,u0mr		; Serial I/O mode select bit
smd1_u0mr		.btequ		1,u0mr		;
smd2_u0mr		.btequ		2,u0mr		;
ckdir_u0mr		.btequ		3,u0mr		; Internal/external clock select bit
stps_u0mr		.btequ		4,u0mr		; Stop bit length select bit
pry_u0mr		.btequ		5,u0mr		; Odd/even parity select bit
prye_u0mr		.btequ		6,u0mr		; Parity enable bit
;
u0brg			.equ		00a1h		; UART0 bit rate register ; Use "MOV" instruction when writing to this register.
;
u0tb			.equ		00a2h		; UART0 transmit buffer register ; Use "MOV" instruction when writing to this register.
u0tbl			.equ		u0tb		;       Low
u0tbh			.equ		u0tb+1		;       High
;
u0c0			.equ		00a4h		; UART0 transmit/receive control register0
clk0_u0c0		.btequ		0,u0c0		; BRG count source select bit
clk1_u0c0		.btequ		1,u0c0		;
txept_u0c0		.btequ		3,u0c0		; Transmit register empty flag
nch_u0c0		.btequ		5,u0c0		; Data output select bit
ckpol_u0c0		.btequ		6,u0c0		; CLK polarity select bit
uform_u0c0		.btequ		7,u0c0		; Transfer format select bit
;
u0c1			.equ		00a5h		; UART0 transmit/receive control register1
te_u0c1			.btequ		0,u0c1		; Transmit enable bit
ti_u0c1			.btequ		1,u0c1		; Transmit buffer empty flag
re_u0c1			.btequ		2,u0c1		; Receive enable bit
ri_u0c1			.btequ		3,u0c1		; Receive complete flag
u0irs_u0c1		.btequ		4,u0c1		; UART0 transmit interrupt cause select bit
u0rrm_u0c1		.btequ		5,u0c1		; UART0 continuous receive mode enable bit
;
u0rb			.equ		00a6h		; UART0 receive buffer register
u0rbl			.equ		u0rb        ;       Low
u0rbh			.equ		u0rb+1		;       High
oer_u0rb		.btequ		4,u0rbh		; Overrun error flag
fer_u0rb		.btequ		5,u0rbh		; Framing error flag
per_u0rb		.btequ		6,u0rbh		; Parity error flag
sum_u0rb		.btequ		7,u0rbh		; Error sum flag
;
u1mr			.equ		00a8h		; UART1 transmit/receive mode register
smd0_u1mr		.btequ		0,u1mr		; Serial I/O mode select bit
smd1_u1mr		.btequ		1,u1mr		;
smd2_u1mr		.btequ		2,u1mr		;
ckdir_u1mr		.btequ		3,u1mr		; Internal/external clock select bit
stps_u1mr		.btequ		4,u1mr		; Stop bit length select bit
pry_u1mr		.btequ		5,u1mr		; Odd/even parity select bit
prye_u1mr		.btequ		6,u1mr		; Parity enable bit
;
u1brg			.equ		00a9h		; UART1 bit rate register ; Use "MOV" instruction when writing to this register.
;
u1tb			.equ		00aah		; UART1 transmit buffer register ; Use "MOV" instruction when writing to this register.
u1tbl			.equ		u1tb		;       Low
u1tbh			.equ		u1tb+1		;       High
;
u1c0			.equ		00ach		; UART1 transmit/receive control register0
clk0_u1c0		.btequ		0,u1c0		; BRG count source select bit
clk1_u1c0		.btequ		1,u1c0		;
txept_u1c0		.btequ		3,u1c0		; Transmit register empty flag
nch_u1c0		.btequ		5,u1c0		; Data output select bit
ckpol_u1c0		.btequ		6,u1c0		; CLK polarity select bit
uform_u1c0		.btequ		7,u1c0		; Transfer format select bit
;
u1c1			.equ		00adh		; UART1 transmit/receive control register1
te_u1c1			.btequ		0,u1c1		; Transmit enable bit
ti_u1c1			.btequ		1,u1c1		; Transmit buffer empty flag
re_u1c1			.btequ		2,u1c1		; Receive enable bit
ri_u1c1			.btequ		3,u1c1		; Receive complete flag
u1irs_u1c1		.btequ		4,u1c1		; UART1 transmit interrupt cause select bit
u1rrm_u1c1		.btequ		5,u1c1		; UART1 continuous receive mode enable bit
;
u1rb			.equ		00aeh		; UART1 receive buffer register
u1rbl			.equ		u1rb        ;       Low
u1rbh			.equ		u1rb+1		;       High
oer_u1rb		.btequ		4,u1rbh		; Overrun error flag
fer_u1rb		.btequ		5,u1rbh		; Framing error flag
per_u1rb		.btequ		6,u1rbh		; Parity error flag
sum_u1rb		.btequ		7,u1rbh		; Error sum flag
;
;-------------------------------------------------------
;   SS control register H
;-------------------------------------------------------
sscrh			.equ		00b8h
;
cks0_sscrh		.btequ		0,sscrh		; Transfer clock rate select bit
cks1_sscrh		.btequ		1,sscrh		; 
cks2_sscrh		.btequ		2,sscrh		; 
mss_sscrh		.btequ		5,sscrh		; Master/Slave device select bit
rsstp_sscrh		.btequ		6,sscrh		; Receive single stop bit 
;
;-------------------------------------------------------
;   IIC bus control register 1
;-------------------------------------------------------
iccr1			.equ		00b8h
;
cks0_iccr1		.btequ		0,iccr1		; Transmit clock select bit 3 to 0
cks1_iccr1		.btequ		1,iccr1		; 
cks2_iccr1		.btequ		2,iccr1		; 
cks3_iccr1		.btequ		3,iccr1		; 
trs_iccr1		.btequ		4,iccr1		; Transfer/Receive select bit
mst_iccr1		.btequ		5,iccr1		; Master/Slave select bit
rcvd_iccr1		.btequ		6,iccr1		; Receive disable bit
ice_iccr1		.btequ		7,iccr1		; IIC bus interface 2A enable bit
;
;-------------------------------------------------------
;   SS control register L
;-------------------------------------------------------
sscrl			.equ		00b9h
;
sres_sscrl		.btequ		1,sscrl		; SSUA control part reset bit
solp_sscrl		.btequ		4,sscrl		; SOL write protect bit
sol_sscrl		.btequ		5,sscrl		; Serial data output value setting bit
;
;-------------------------------------------------------
;   IIC bus control register 2
;-------------------------------------------------------
iccr2			.equ		00b9h
;
iicrst_iccr2	.btequ		1,iccr2		; IIC control part reset bit
sclo_iccr2		.btequ		3,iccr2		; SCL monitor flag
sdaop_iccr2		.btequ		4,iccr2		; SDAO write protect bit
sdao_iccr2		.btequ		5,iccr2		; SDA output value control bit
scp_iccr2		.btequ		6,iccr2		; Start/Stop condition generation disable bit
bbsy_iccr2		.btequ		7,iccr2		; Bus busy bit
;
;-------------------------------------------------------
;   SS mode register 
;-------------------------------------------------------
ssmr			.equ		00bah
;
bc0_ssmr	    .btequ		0,ssmr		; Bit counter 2 to 0
bc1_ssmr		.btequ		1,ssmr		; 
bc2_ssmr		.btequ		2,ssmr		; 
cphs_ssmr		.btequ		5,ssmr		; SSCK clock phase select bit 
cpos_ssmr		.btequ		6,ssmr		; SSCK clock polarity select bit 
mls_ssmr		.btequ		7,ssmr		; MSB first/ LSB first select bit 
;
;-------------------------------------------------------
;   IIC bus mode register
;-------------------------------------------------------
icmr			.equ		00bah
;
bc0_icmr	    .btequ		0,icmr		; Bit counter 2 to 0
bc1_icmr		.btequ		1,icmr		; 
bc2_icmr		.btequ		2,icmr		; 
bcwp_icmr		.btequ		3,icmr		; BC write protect bit
wait_icmr		.btequ		6,icmr		; Wait insertion bit
mls_icmr		.btequ		7,icmr		; MSB-First/LSB-First select
;
;-------------------------------------------------------
;   SS enable register 
;-------------------------------------------------------
sser			.equ		00bbh
;
ceie_sser		.btequ		0,sser		; Conflict error interrupt enable bit 
re_sser			.btequ		3,sser		; Receive enable bit 
te_sser			.btequ		4,sser		; Transmit enable bit
rie_sser		.btequ		5,sser		; Receive interrupt enable bit 
teie_sser		.btequ		6,sser		; Transmit end interrupt enable bit 
tie_sser		.btequ		7,sser		; Transmit interrupt enable bit 
;
;-------------------------------------------------------
;   IIC bus interrupt enable register
;-------------------------------------------------------
icier			.equ		00bbh
;
ackbt_icier		.btequ		0,icier		; Transmit acknowledge select bit
ackbr_icier		.btequ		1,icier		; Receive acknowledge bit
acke_icier		.btequ		2,icier		; Acknowledge bit judgement select bit
stie_icier		.btequ		3,icier		; Stop condition detection interrupt enable bit
nakie_icier		.btequ		4,icier		; NACK receive interrupt enable bit
rie_icier		.btequ		5,icier		; Receive interrupt enable bit
teie_icier		.btequ		6,icier		; Transmit end interrupt enable bit
tie_icier		.btequ		7,icier		; Transmit interrupt enable bit
;
;-------------------------------------------------------
;   SS status register 
;-------------------------------------------------------
sssr			.equ		00bch
;
ce_sssr  		.btequ		0,sssr		; Conflict error flag
orer_sssr		.btequ		2,sssr		; Overrun error flag
rdrf_sssr		.btequ		5,sssr		; Receive data register ful
tend_sssr		.btequ		6,sssr		; Transmit end
tdre_sssr		.btequ		7,sssr		; Transmit data empty
;
;-------------------------------------------------------
;   IIC bus status register
;-------------------------------------------------------
icsr			.equ		00bch
;
adz_icsr  		.btequ		0,icsr		; General call address recognition flag
aas_icsr		.btequ		1,icsr		; Slave address recognition flag
al_icsr			.btequ		2,icsr		; Arbitration lost flag
stop_icsr		.btequ		3,icsr		; Stop condition detection flag
nackf_icsr		.btequ		4,icsr		; No acknowledge detection flag
rdrf_icsr		.btequ		5,icsr		; Receive data register full
tend_icsr		.btequ		6,icsr		; Transmit end
tdre_icsr		.btequ		7,icsr		; Transmit data empty
;
;-------------------------------------------------------
;   SS mode register 2
;-------------------------------------------------------
ssmr2			.equ		00bdh
;
ssums_ssmr2		.btequ		0,ssmr2		; SSUA mode select bit
csos_ssmr2		.btequ		1,ssmr2		; SCS pin open drain output select bit
soos_ssmr2		.btequ		2,ssmr2		; SSO pin open drain output select bit
sckos_ssmr2		.btequ		3,ssmr2		; SSCK pin open drain output select bit
css0_ssmr2		.btequ		4,ssmr2		; SCS pin selsct bit
css1_ssmr2		.btequ		5,ssmr2		; SCS pin select bit
scks_ssmr2		.btequ		6,ssmr2		; SSCK pin select bit
bide_ssmr2		.btequ		7,ssmr2		; Bidirectional mode enable bit
;
;-------------------------------------------------------
;   Slave address register
;-------------------------------------------------------
sar				.equ		00bdh
;
fs_sar			.btequ		0,sar		; Format select bit
SVA0_sar		.btequ		1,sar		; Slave address 6 to 0
SVA1_sar		.btequ		2,sar		; 
SVA2_sar		.btequ		3,sar		; 
SVA3_sar		.btequ		4,sar		; 
SVA4_sar		.btequ		5,sar		; 
SVA5_sar		.btequ		6,sar		; 
SVA6_sar		.btequ		7,sar		; 
;
;-------------------------------------------------------
;   SS transmit data register
;-------------------------------------------------------
sstdr			.equ		00beh		;
;
;-------------------------------------------------------
;   IIC bus transmit data register
;-------------------------------------------------------
icdrt			.equ		00beh		;
;
;-------------------------------------------------------
;   SS receive data register
;-------------------------------------------------------
ssrdr			.equ		00bfh		;
;
;-------------------------------------------------------
;   IIC bus receive data register
;-------------------------------------------------------
icdrr			.equ		00bfh		;
;
;-------------------------------------------------------
;   A-D registers ADi
;-------------------------------------------------------
ad				.equ		00c0h		; A-D register
adl				.equ		ad			;       Low
adh				.equ		ad+1		;       High
;
;-------------------------------------------------------
;   A-D control register2
;-------------------------------------------------------
adcon2			.equ		00d4h		; A-D control register 2
smp				.btequ		0,adcon2	; A-D conversion method select bit
;
;-------------------------------------------------------
;   A-D control register0
;-------------------------------------------------------
adcon0			.equ		00d6h		; A-D control register0
;
ch0				.btequ		0,adcon0	; Analog input pin select bit
ch1				.btequ		1,adcon0	;
ch2				.btequ		2,adcon0	;
md				.btequ		3,adcon0	; A-D operation mode select bit
adgsel0			.btequ		4,adcon0	; A-D input group select bit
adcap			.btequ		5,adcon0	; A-D conversion automatic start bit 
adst			.btequ		6,adcon0	; A-D conversion start flag
cks0			.btequ		7,adcon0	; Frequency select bit0
cks0_adcon0 	.btequ		7,adcon0	; Frequency select bit0
;
;-------------------------------------------------------
;   A-D control register1
;-------------------------------------------------------
adcon1			.equ		00d7h		; A-D control register1
;
bits			.btequ		3,adcon1	; 8/10-bit mode select bit
cks1			.btequ		4,adcon1	; Frequency select bit1
cks1_adcon1 	.btequ		4,adcon1	; Frequency select bit1
vcut			.btequ		5,adcon1	; Vref connect bit
;
;-------------------------------------------------------
;	Port
;-------------------------------------------------------;
p0				.equ		00e0h		; Port P0
p0_0			.btequ		0,p0        ; Port P00 bit
p0_1			.btequ		1,p0        ; Port P01 bit
p0_2			.btequ		2,p0        ; Port P02 bit
p0_3			.btequ		3,p0        ; Port P03 bit
p0_4			.btequ		4,p0        ; Port P04 bit
p0_5			.btequ		5,p0        ; Port P05 bit
p0_6			.btequ		6,p0        ; Port P06 bit
p0_7			.btequ		7,p0        ; Port P07 bit
;
p1				.equ		00e1h		; Port P1
p1_0			.btequ		0,p1        ; Port P10 bit
p1_1			.btequ		1,p1        ; Port P11 bit
p1_2			.btequ		2,p1        ; Port P12 bit
p1_3			.btequ		3,p1        ; Port P13 bit
p1_4			.btequ		4,p1        ; Port P14 bit
p1_5			.btequ		5,p1        ; Port P15 bit
p1_6			.btequ		6,p1        ; Port P16 bit
p1_7			.btequ		7,p1        ; Port P17 bit
;
pd0				.equ		00e2h		; Port P0 direction register
pd0_0			.btequ		0,pd0       ; Port P00 direction bit
pd0_1			.btequ		1,pd0       ; Port P01 direction bit
pd0_2			.btequ		2,pd0       ; Port P02 direction bit
pd0_3			.btequ		3,pd0       ; Port P03 direction bit
pd0_4			.btequ		4,pd0       ; Port P04 direction bit
pd0_5			.btequ		5,pd0       ; Port P05 direction bit
pd0_6			.btequ		6,pd0       ; Port P06 direction bit
pd0_7			.btequ		7,pd0       ; Port P07 direction bit
;
pd1				.equ		00e3h		; Port P1 direction register
pd1_0			.btequ		0,pd1       ; Port P10 direction bit
pd1_1			.btequ		1,pd1       ; Port P11 direction bit
pd1_2			.btequ		2,pd1       ; Port P12 direction bit
pd1_3			.btequ		3,pd1       ; Port P13 direction bit
pd1_4			.btequ		4,pd1       ; Port P14 direction bit
pd1_5			.btequ		5,pd1       ; Port P15 direction bit
pd1_6			.btequ		6,pd1       ; Port P16 direction bit
pd1_7			.btequ		7,pd1       ; Port P17 direction bit
;
p2				.equ		00e4h		; Port P2
p2_0			.btequ		0,p2        ; Port P20 bit
p2_1			.btequ		1,p2        ; Port P21 bit
p2_2			.btequ		2,p2        ; Port P22 bit
p2_3			.btequ		3,p2        ; Port P23 bit
p2_4			.btequ		4,p2        ; Port P24 bit
p2_5			.btequ		5,p2        ; Port P25 bit
p2_6			.btequ		6,p2        ; Port P26 bit
p2_7			.btequ		7,p2        ; Port P27 bit
;
p3				.equ		00e5h		; Port P3
p3_0			.btequ		0,p3        ; Port P30 bit
p3_1			.btequ		1,p3        ; Port P31 bit
p3_3			.btequ		3,p3        ; Port P33 bit
p3_4			.btequ		4,p3        ; Port P34 bit
p3_5			.btequ		5,p3        ; Port P35 bit
p3_7			.btequ		7,p3        ; Port P37 bit
;
pd2				.equ		00e6h		; Port P2 direction register
pd2_0			.btequ		0,pd2       ; Port P20 direction bit
pd2_1			.btequ		1,pd2       ; Port P21 direction bit
pd2_2			.btequ		2,pd2       ; Port P22 direction bit
pd2_3			.btequ		3,pd2       ; Port P23 direction bit
pd2_4			.btequ		4,pd2       ; Port P24 direction bit
pd2_5			.btequ		5,pd2       ; Port P25 direction bit
pd2_6			.btequ		6,pd2       ; Port P26 direction bit
pd2_7			.btequ		7,pd2       ; Port P27 direction bit
;
pd3				.equ		00e7h		; Port P3 direction register
pd3_0			.btequ		0,pd3       ; Port P30 direction bit
pd3_1			.btequ		1,pd3       ; Port P31 direction bit
pd3_3			.btequ		3,pd3       ; Port P33 direction bit
pd3_4			.btequ		4,pd3       ; Port P34 direction bit
pd3_5			.btequ		5,pd3       ; Port P35 direction bit
pd3_7			.btequ		7,pd3       ; Port P37 direction bit
;
p4				.equ		00e8h		; Port P4
p4_2			.btequ		2,p4        ; Port P42 bit
p4_3			.btequ		3,p4        ; Port P43 bit
p4_4			.btequ		4,p4        ; Port P44 bit
p4_5			.btequ		5,p4        ; Port P45 bit
p4_6			.btequ		6,p4        ; Port P46 bit
p4_7			.btequ		7,p4        ; Port P47 bit
;
pd4				.equ		00eah		; Port P4 direction register
pd4_3			.btequ		3,pd4       ; Port P43 direction bit
pd4_4			.btequ		4,pd4       ; Port P44 direction bit
pd4_5			.btequ		5,pd4       ; Port P45 direction bit
;
p6				.equ		00ech		; Port P6
p6_0			.btequ		0,p6        ; Port P60 bit
p6_1			.btequ		1,p6        ; Port P61 bit
p6_2			.btequ		2,p6        ; Port P62 bit
p6_3			.btequ		3,p6        ; Port P63 bit
p6_4			.btequ		4,p6        ; Port P64 bit
p6_5			.btequ		5,p6        ; Port P65 bit
p6_6			.btequ		6,p6        ; Port P66 bit
p6_7			.btequ		7,p6        ; Port P67 bit
;
pd6				.equ		00eeh		; Port P6 direction register
pd6_0			.btequ		0,pd6       ; Port P60 direction bit
pd6_1			.btequ		1,pd6       ; Port P61 direction bit
pd6_2			.btequ		2,pd6       ; Port P62 direction bit
pd6_3			.btequ		3,pd6       ; Port P63 direction bit
pd6_4			.btequ		4,pd6       ; Port P64 direction bit
pd6_5			.btequ		5,pd6       ; Port P65 direction bit
pd6_6			.btequ		6,pd6       ; Port P66 direction bit
pd6_7			.btequ		7,pd6       ; Port P67 direction bit
;
;-------------------------------------------------------
;   Port P2 drive capacity control register
;-------------------------------------------------------
p2drr			.equ		00f4h
;
p2drr0			.btequ		0,p2drr		; P20 drive capacity
p2drr1			.btequ		1,p2drr		; P21 drive capacity
p2drr2			.btequ		2,p2drr		; P22 drive capacity
p2drr3			.btequ		3,p2drr		; P23 drive capacity
p2drr4			.btequ		4,p2drr		; P24 drive capacity
p2drr5			.btequ		5,p2drr		; P25 drive capacity
p2drr6			.btequ		6,p2drr		; P26 drive capacity
p2drr7			.btequ		7,p2drr		; P27 drive capacity
;
;-------------------------------------------------------
;   UART1 function select register
;-------------------------------------------------------
u1sr			.equ		00f5h		;
;
;-------------------------------------------------------
;   Port mode register
;-------------------------------------------------------
pmr				.equ		00f8h
u1pinsel		.btequ		4,pmr       ; Port/TXD1,RXD1 select bit
iicsel			.btequ		7,pmr       ; SSU/IIC select bit
;
;-------------------------------------------------------
;   External input enable register
;-------------------------------------------------------
inten			.equ		00f9h
int0en			.btequ		0,inten		; INT0 input enable bit
int0pl			.btequ		1,inten		; INT0 input polarity select bit
int1en			.btequ		2,inten		; INT1 input enable bit
int1pl			.btequ		3,inten		; INT1 input polarity select bit
int2en			.btequ		4,inten		; INT2 input enable bit
int2pl			.btequ		5,inten		; INT2 input polarity select bit
int3en			.btequ		6,inten		; INT3 input enable bit
int3pl			.btequ		7,inten		; INT3 input polarity select bit
;
;-------------------------------------------------------
;   INT input filter select register
;-------------------------------------------------------
intf			.equ		00fah
int0f0			.btequ		0,intf		; INT0 input filter select bit
int0f1			.btequ		1,intf		;
int1f0			.btequ		2,intf		; INT1 input filter select bit
int1f1			.btequ		3,intf		;
int2f0			.btequ		4,intf		; INT2 input filter select bit
int2f1			.btequ		5,intf		;
int3f0			.btequ		6,intf		; INT3 input filter select bit
int3f1			.btequ		7,intf		;
;
;-------------------------------------------------------
;   Key input enable register
;-------------------------------------------------------
kien			.equ		00fbh
ki0en			.btequ		0,kien		; KI0 input enable bit
ki0pl			.btequ		1,kien		; KI0 input polarity select bit
ki1en			.btequ		2,kien		; KI1 input enable bit
ki1pl			.btequ		3,kien		; KI1 input polarity select bit
ki2en			.btequ		4,kien		; KI2 input enable bit
ki2pl			.btequ		5,kien		; KI2 input polarity select bit
ki3en			.btequ		6,kien		; KI3 input enable bit
ki3pl			.btequ		7,kien		; KI3 input polarity select bit
;
;-------------------------------------------------------
;   Pull-up control registers
;-------------------------------------------------------
pur0			.equ		00fch		; Pull-up control register0
pu00			.btequ		0,pur0		; P00 to P03 pull-up
pu01			.btequ		1,pur0		; P04 to P07 pull-up
pu02			.btequ		2,pur0		; P10 to P13 pull-up
pu03			.btequ		3,pur0		; P14 to P17 pull-up
pu04			.btequ		4,pur0		; P20 to P23 pull-up
pu05			.btequ		5,pur0		; P24 to P27 pull-up
pu06			.btequ		6,pur0		; P30, P31, P33 pull-up
pu07			.btequ		7,pur0		; P34, P35, P37 pull-up
;
pur1			.equ		00fdh		; Pull-up control register1
pu10			.btequ		0,pur1		; P43 pull-up
pu11			.btequ		1,pur1		; P44, P45 pull-up
pu14			.btequ		4,pur1		; P60 to P63 pull-up
pu15			.btequ		5,pur1		; P64 to P67 pull-up
;
;------------------------------------------------------
;  Timer RA control register
;------------------------------------------------------
tracr			.equ		0100h
tstart_tracr	.btequ		0,tracr		; Timer RA count start bit
tcstf_tracr		.btequ		1,tracr		; Timer RA count status flag
tstop_tracr		.btequ		2,tracr		; Timer RA count forcible stop bit
tedgf_tracr		.btequ		4,tracr		; Active edge reception flag
tundf_tracr		.btequ		5,tracr		; Timer RA underflow flag
;
;------------------------------------------------------
;  Timer RA I/O control register
;------------------------------------------------------
traioc			.equ		0101h
tedgsel_traioc	.btequ		0,traioc	; TRAIO polarity switch bit
topcr_traioc	.btequ		1,traioc	; TRAIO output control bit
toena_traioc	.btequ		2,traioc	; TRAO output enable bit
tiosel_traioc	.btequ		3,traioc	; INT1/TRAIO select bit
tipf0_traioc	.btequ		4,traioc	; TRAIO input filter select bit
tipf1_traioc	.btequ		5,traioc	;
;
;------------------------------------------------------
;  Timer RA mode register
;------------------------------------------------------
tramr			.equ		0102h
tmod0_tramr		.btequ		0,tramr		; Timer RA operating mode select bit
tmod1_tramr		.btequ		1,tramr		; 
tmod2_tramr		.btequ		2,tramr		; 
tck0_tramr		.btequ		4,tramr		; Timer RA count source select bit
tck1_tramr		.btequ		5,tramr		; 
tck2_tramr		.btequ		6,tramr		; 
tckcut_tramr	.btequ		7,tramr		; Timer RA count source cutoff bit
;
;-------------------------------------------------------
;   Timer RA registers
;-------------------------------------------------------
trapre			.equ		0103h		; Timer RA prescaler register
;
tra				.equ		0104h		; Timer RA register
;
;-------------------------------------------------------
;   LIN control register
;-------------------------------------------------------
lincr			.equ		0106h
sfie_lincr		.btequ		0,lincr		; Synchronous field measurementcompleted interrupt enable bit
sbie_lincr		.btequ		1,lincr		; Synchronous break detection interrupt enable bit
bcie_lincr		.btequ		2,lincr		; Bus conflict detection interrupt enable bit
rxdsf_lincr		.btequ		3,lincr		; RxD0 input status flag
lstart_lincr	.btequ		4,lincr		; Synchronous Break detection start bit
sbe_lincr		.btequ		5,lincr		; RxD0 input unmasking timing select bit
mst_lincr		.btequ		6,lincr		; LIN operation mode setting bit
line_lincr		.btequ		7,lincr		; LIN operation start bit
;
;-------------------------------------------------------
;   LIN status register
;-------------------------------------------------------
linst			.equ		0107h
sfdct_linst		.btequ		0,linst		; Synchronous field measurementcompleted flag
sbdct_linst		.btequ		1,linst		; Synchronous break detection flag
bcdct_linst		.btequ		2,linst		; Bus collision detection flag
b0clr_linst		.btequ		3,linst		; SFDCT flag clear bit
b1clr_linst		.btequ		4,linst		; SBDCT flag clear bit
b2clr_linst		.btequ		5,linst		; BCDCT flag clear bit
;
;------------------------------------------------------
;  Timer RB control register
;------------------------------------------------------
trbcr			.equ		0108h
tstart_trbcr	.btequ		0,trbcr		; Timer RB count start bit
tcstf_trbcr		.btequ		1,trbcr		; Timer RB count status flag
tstop_trbcr		.btequ		2,trbcr		; Timer RB count forcible stop bit
;
;------------------------------------------------------
;  Timer RB one-shot control register
;------------------------------------------------------
trbocr			.equ		0109h
tosst_trbocr	.btequ		0,trbocr	; Timer RB one-shot start bit
tossp_trbocr	.btequ		1,trbocr	; Timer RB one-shot stop bit
tosstf_trbocr	.btequ		2,trbocr	; Timer RB one-shot status flag
;
;------------------------------------------------------
;  Timer RB I/O control register
;------------------------------------------------------
trbioc			.equ		010Ah
topl_trbioc		.btequ		0,trbioc	; Timer RB output level select bit
tocnt_trbioc	.btequ		1,trbioc	; Timer RB output switch bit
inostg_trbioc	.btequ		2,trbioc	; One-shot trigger control bit
inoseg_trbioc	.btequ		3,trbioc	; One-shot trigger polarity select bit
;
;------------------------------------------------------
;  Timer RB mode register
;------------------------------------------------------
trbmr			.equ		010Bh
tmod0_trbmr		.btequ		0,trbmr		; Timer RB operating mode select bit
tmod1_trbmr		.btequ		1,trbmr		; 
twrc_trbmr		.btequ		3,trbmr		; Timer RB write control bit
tck0_trbmr		.btequ		4,trbmr		; Timer RB count source select bit
tck1_trbmr		.btequ		5,trbmr		; 
tckcut_trbmr	.btequ		7,trbmr		; Timer RB count source cutoff bit
;
;-------------------------------------------------------
;   Timer RB registers
;-------------------------------------------------------
trbpre			.equ		010ch		; Timer RB prescaler register
;
trbsc			.equ		010dh		; Timer RB secondary register
;
trbpr			.equ		010eh		; Timer RB primary register
;
;------------------------------------------------------
;  Timer RE seconds data register / Timer RE counter data register
;------------------------------------------------------
tresec			.equ		0118h
sc00_tresec		.btequ		0,tresec	; 1st digit of seconds count bits
sc01_tresec		.btequ		1,tresec	; 
sc02_tresec		.btequ		2,tresec	; 
sc03_tresec		.btequ		3,tresec	; 
sc10_tresec		.btequ		4,tresec	; 2nd digit of seconds count bits
sc11_tresec		.btequ		5,tresec	; 
sc12_tresec		.btequ		6,tresec	; 
bsy_tresec		.btequ		7,tresec	; Timer RE busy flag
;
;------------------------------------------------------
;  Timer RE minutes data register / Timer RE compare data register
;------------------------------------------------------
tremin			.equ		0119h
mn00_tremin		.btequ		0,tremin	; 1st digit of minutes count bits
mn01_tremin		.btequ		1,tremin	; 
mn02_tremin		.btequ		2,tremin	; 
mn03_tremin		.btequ		3,tremin	; 
mn10_tremin		.btequ		4,tremin	; 2nd digit of minutes count bits
mn11_tremin		.btequ		5,tremin	; 
mn12_tremin		.btequ		6,tremin	; 
bsy_tremin		.btequ		7,tremin	; Timer RE busy flag
;
;------------------------------------------------------
;  Timer RE Hours Data Register
;------------------------------------------------------
trehr			.equ		011ah
hr00_trehr		.btequ		0,trehr		; 1st digit of hours count bits
hr01_trehr		.btequ		1,trehr		; 
hr02_trehr		.btequ		2,trehr		; 
hr03_trehr		.btequ		3,trehr		; 
hr10_trehr		.btequ		4,trehr		; 2nd digit of hours count bits
hr11_trehr		.btequ		5,trehr		; 
bsy_trehr		.btequ		7,trehr		; Timer RE busy flag
;
;------------------------------------------------------
;  Timer RE Days of Week Data Register
;------------------------------------------------------
trewk			.equ		011bh
wk0_trewk		.btequ		0,trewk		; Days of week count bits
wk1_trewk		.btequ		1,trewk		; 
wk2_trewk		.btequ		2,trewk		; 
bsy_trewk		.btequ		7,trewk		; Timer RE busy flag
;
;------------------------------------------------------
;  Timer RE control register1
;------------------------------------------------------
trecr1			.equ		011ch
tcstf_trecr1	.btequ		1,trecr1	; Timer RE count status flag
toena_trecr1	.btequ		2,trecr1	; TREO pin output enable bit
int_trecr1		.btequ		3,trecr1	; Interrupt request timing bit
trerst_trecr1	.btequ		4,trecr1	; Timer RE reset bit
pm_trecr1		.btequ		5,trecr1	; A.M. / P.M. bit
h12_h24_trecr1	.btequ		6,trecr1	; Operating mode select bit
tstart_trecr1	.btequ		7,trecr1	; Timer RE count start bit
;
;------------------------------------------------------
;  Timer RE control register2
;------------------------------------------------------
trecr2			.equ		011dh
seie_trecr2		.btequ		0,trecr2	; Periodic interrupt triggered every second enable bit
mnie_trecr2		.btequ		1,trecr2	; Periodic interrupt triggered every minute enable bit
hrie_trecr2		.btequ		2,trecr2	; Periodic interrupt triggered every hour enable bit
dyie_trecr2		.btequ		3,trecr2	; Periodic interrupt triggered every day enable bit
wkie_trecr2		.btequ		4,trecr2	; Periodic interrupt triggered every week enable bit
comie_trecr2	.btequ		5,trecr2	; Compare match interrupt enable bit
;
;------------------------------------------------------
;  Timer RE count source select register
;------------------------------------------------------
trecsr			.equ		011eh
rcs0_trecsr		.btequ		0,trecsr	; Count source select bit
rcs1_trecsr		.btequ		1,trecsr	; 
rcs2_trecsr		.btequ		2,trecsr	; 4-Bit counter select bit
rcs3_trecsr		.btequ		3,trecsr	; Real-Time clock mode select bit
rcs5_trecsr		.btequ		5,trecsr	; Clock output select bit
rcs6_trecsr		.btequ		6,trecsr	; 
;
;------------------------------------------------------
;  Timer RD start register
;------------------------------------------------------
trdstr			.equ		0137h
tstart0_trdstr	.btequ		0,trdstr	; TRD0 count start bit
tstart1_trdstr	.btequ		1,trdstr	; TRD1 count start bit
csel0_trdstr	.btequ		2,trdstr	; TRD0 count stop bit
csel1_trdstr	.btequ		3,trdstr	; TRD1 count stop bit

tstop0_trdstr	.btequ		csel0_trdstr
tstop1_trdstr	.btequ		csel1_trdstr
;
;------------------------------------------------------
;  Timer RD mode register
;------------------------------------------------------
trdmr			.equ		0138h
sync_trdmr		.btequ		0,trdmr		; Timer RD synchronous bit
bfc0_trdmr		.btequ		4,trdmr		; GRC0 register function selection bit
bfd0_trdmr		.btequ		5,trdmr		; GRD0 register function selection bit
bfc1_trdmr		.btequ		6,trdmr		; GRC1 register function selection bit
bfd1_trdmr		.btequ		7,trdmr		; GRD1 register function selection bit

trdmdr			.equ		trdmr
sync_trdmdr		.btequ		sync_trdmr
bfc0_trdmdr		.btequ		bfc0_trdmr
bfd0_trdmdr		.btequ		bfd0_trdmr
bfc1_trdmdr		.btequ		bfc1_trdmr
bfd1_trdmdr		.btequ		bfd1_trdmr
;
;------------------------------------------------------
;  Timer RD PWM mode register
;------------------------------------------------------
trdpmr			.equ		0139h
pwmb0_trdpmr	.btequ		0,trdpmr	; PWM mode of TRDIOB0 selection bit
pwmc0_trdpmr	.btequ		1,trdpmr	; PWM mode of TRDIOC0 selection bit
pwmd0_trdpmr	.btequ		2,trdpmr	; PWM mode of TRDIOD0 selection bit
pwmb1_trdpmr	.btequ		4,trdpmr	; PWM mode of TRDIOB1 selection bit
pwmc1_trdpmr	.btequ		5,trdpmr	; PWM mode of TRDIOC1 selection bit
pwmd1_trdpmr	.btequ		6,trdpmr	; PWM mode of TRDIOD1 selection bit
;
;------------------------------------------------------
;  Timer RD function control register
;------------------------------------------------------
trdfcr			.equ		013ah
cmd0_trdfcr		.btequ		0,trdfcr	; Combination mode selection bit
cmd1_trdfcr		.btequ		1,trdfcr	; 
ols0_trdfcr		.btequ		2,trdfcr	; Normal-Phase output level selection bit
ols1_trdfcr		.btequ		3,trdfcr	; Counter-Phase output level selection bit
adtrg_trdfcr	.btequ		4,trdfcr	; A/D trigger enable bit
adeg_trdfcr		.btequ		5,trdfcr	; A/D trigger edge selection bit
stclk_trdfcr	.btequ		6,trdfcr	; External clock input selection bit
pwm3_trdfcr		.btequ		7,trdfcr	; Complementary PWM mode (Pair) selection bit
;
;------------------------------------------------------
;  Timer RD output master enable register1
;------------------------------------------------------
trdoer1			.equ		013bh
ea0_trdoer1		.btequ		0,trdoer1	; TRDIOA0 output disable bit
eb0_trdoer1		.btequ		1,trdoer1	; TRDIOB0 output disable bit
ec0_trdoer1		.btequ		2,trdoer1	; TRDIOC0 output disable bit
ed0_trdoer1		.btequ		3,trdoer1	; TRDIOD0 output disable bit
ea1_trdoer1		.btequ		4,trdoer1	; TRDIOA1 output disable bit
eb1_trdoer1		.btequ		5,trdoer1	; TRDIOB1 output disable bit
ec1_trdoer1		.btequ		6,trdoer1	; TRDIOC1 output disable bit
ed1_trdoer1		.btequ		7,trdoer1	; TRDIOD1 output disable bit
;
;------------------------------------------------------
;  Timer RD output master enable register2
;------------------------------------------------------
trdoer2			.equ		013ch
pto_trdoer2		.btequ		7,trdoer2	; INT0 of pulse output forced cutoff signal input enabled bit
;
;------------------------------------------------------
;  Timer RD output control register
;------------------------------------------------------
trdocr			.equ		013dh
toa0_trdocr		.btequ		0,trdocr	; TRDIOA0 output level selection bit
tob0_trdocr		.btequ		1,trdocr	; TRDIOB0 output level selection bit
toc0_trdocr		.btequ		2,trdocr	; TRDIOC0 initial output level selection bit
tod0_trdocr		.btequ		3,trdocr	; TRDIOD0 initial output level selection bit
toa1_trdocr		.btequ		4,trdocr	; TRDIOA1 initial output level selection bit
tob1_trdocr		.btequ		5,trdocr	; TRDIOB1 initial output level selection bit
toc1_trdocr		.btequ		6,trdocr	; TRDIOC1 initial output level selection bit
tod1_trdocr		.btequ		7,trdocr	; TRDIOD1 initial output level selection bit
;
;------------------------------------------------------
;  Timer RD digital filter function select register0
;------------------------------------------------------
trddf0			.equ		013eh
dfa_trddf0		.btequ		0,trddf0	; TRDIOA pin digital filter function selection bit
dfb_trddf0		.btequ		1,trddf0	; TRDIOB pin digital filter function selection bit
dfc_trddf0		.btequ		2,trddf0	; TRDIOC pin digital filter function selection bit
dfd_trddf0		.btequ		3,trddf0	; TRDIOD pin digital filter function selection bit
dfck0_trddf0	.btequ		6,trddf0	; Clock selection bit for digital filter function
dfck1_trddf0	.btequ		7,trddf0	; 
;
;------------------------------------------------------
;  Timer RD digital filter function select register1
;------------------------------------------------------
trddf1			.equ		013fh
dfa_trddf1		.btequ		0,trddf1	; TRDIOA pin digital filter function selection bit
dfb_trddf1		.btequ		1,trddf1	; TRDIOB pin digital filter function selection bit
dfc_trddf1		.btequ		2,trddf1	; TRDIOC pin digital filter function selection bit
dfd_trddf1		.btequ		3,trddf1	; TRDIOD pin digital filter function selection bit
dfck0_trddf1	.btequ		6,trddf1	; Clock selection bit for digital filter function
dfck1_trddf1	.btequ		7,trddf1	; 
;
;------------------------------------------------------
;  Timer RD control register0
;------------------------------------------------------
trdcr0			.equ		0140h
tck0_trdcr0		.btequ		0,trdcr0	; Count source selection bit
tck1_trdcr0		.btequ		1,trdcr0	; 
tck2_trdcr0		.btequ		2,trdcr0	; 
ckeg0_trdcr0	.btequ		3,trdcr0	; External clock edge selection bit
ckeg1_trdcr0	.btequ		4,trdcr0	; 
cclr0_trdcr0	.btequ		5,trdcr0	; TRD0 counter clear selection bit
cclr1_trdcr0	.btequ		6,trdcr0	; 
cclr2_trdcr0	.btequ		7,trdcr0	; 

tpsc0_trdcr0	.btequ		tck0_trdcr0
tpsc1_trdcr0	.btequ		tck1_trdcr0
tpsc2_trdcr0	.btequ		tck2_trdcr0
;
;------------------------------------------------------
;  Timer RD I/O control register A0
;------------------------------------------------------
trdiora0		.equ		0141h
ioa0_trdiora0	.btequ		0,trdiora0	; TRDGRA control bit
ioa1_trdiora0	.btequ		1,trdiora0	; 
ioa2_trdiora0	.btequ		2,trdiora0	; TRDGRA mode selection bit
ioa3_trdiora0	.btequ		3,trdiora0	; Input capture input switch bit
iob0_trdiora0	.btequ		4,trdiora0	; TRDGRB control bit
iob1_trdiora0	.btequ		5,trdiora0	; 
iob2_trdiora0	.btequ		6,trdiora0	; TRDGRB mode selection bit
;
;------------------------------------------------------
;  Timer RD I/O control register C0
;------------------------------------------------------
trdiorc0		.equ		0142h
ioc0_trdiorc0	.btequ		0,trdiorc0	; TRDGRC control bit
ioc1_trdiorc0	.btequ		1,trdiorc0	; 
ioc2_trdiorc0	.btequ		2,trdiorc0	; TRDGRC mode selection bit
ioc3_trdiorc0	.btequ		3,trdiorc0	; TRDGRC register function selection bit
iod0_trdiorc0	.btequ		4,trdiorc0	; TRDGRD control bit
iod1_trdiorc0	.btequ		5,trdiorc0	; 
iod2_trdiorc0	.btequ		6,trdiorc0	; TRDGRD mode selection bit
iod3_trdiorc0	.btequ		7,trdiorc0	; TRDGRD register function selection bit
;
;------------------------------------------------------
;  Timer RD status register0
;------------------------------------------------------
trdsr0			.equ		0143h
imfa_trdsr0		.btequ		0,trdsr0	; Input capture / compare match flag A
imfb_trdsr0		.btequ		1,trdsr0	; Input capture / compare match flag B
imfc_trdsr0		.btequ		2,trdsr0	; Input capture / compare match flag C
imfd_trdsr0		.btequ		3,trdsr0	; Input capture / compare match flag D
ovf_trdsr0		.btequ		4,trdsr0	; Overflow flag
;
;------------------------------------------------------
;  Timer RD interruput enable register0
;------------------------------------------------------
trdier0			.equ		0144h
imiea_trdier0	.btequ		0,trdier0	; Input capture / compare match interrupt enable bit A
imieb_trdier0	.btequ		1,trdier0	; Input capture / compare match interrupt enable bit B
imiec_trdier0	.btequ		2,trdier0	; Input capture / compare match interrupt enable bit C
imied_trdier0	.btequ		3,trdier0	; Input capture / compare match interrupt enable bit D
ovie_trdier0	.btequ		4,trdier0	; Overflow / underflow interrupt enable bit
;
;------------------------------------------------------
;  Timer RD PWM mode output level control register0
;------------------------------------------------------
trdpocr0		.equ		0145h
polb_trdpocr0	.btequ		0,trdpocr0	; PWM mode output level control bit B
polc_trdpocr0	.btequ		1,trdpocr0	; PWM mode output level control bit C
pold_trdpocr0	.btequ		2,trdpocr0	; PWM mode output level control bit D
;
;------------------------------------------------------
;  Timer RD counter0
;------------------------------------------------------
trd0			.equ		0146h
;
;------------------------------------------------------
;  Timer RD general register A0
;------------------------------------------------------
trdgra0			.equ		0148h
;
;------------------------------------------------------
;  Timer RD general register B0
;------------------------------------------------------
trdgrb0			.equ		014ah
;
;------------------------------------------------------
;  Timer RD general register C0
;------------------------------------------------------
trdgrc0			.equ		014ch
;
;------------------------------------------------------
;  Timer RD general register D0
;------------------------------------------------------
trdgrd0			.equ		014eh
;
;------------------------------------------------------
;  Timer RD control register1
;------------------------------------------------------
trdcr1			.equ		0150h
tck0_trdcr1		.btequ		0,trdcr1	; Count source selection bit
tck1_trdcr1		.btequ		1,trdcr1	; 
tck2_trdcr1		.btequ		2,trdcr1	; 
ckeg0_trdcr1	.btequ		3,trdcr1	; External clock edge selection bit
ckeg1_trdcr1	.btequ		4,trdcr1	; 
cclr0_trdcr1	.btequ		5,trdcr1	; TRD1 counter clear selection bit
cclr1_trdcr1	.btequ		6,trdcr1	; 
cclr2_trdcr1	.btequ		7,trdcr1	; 

tpsc0_trdcr1	.btequ		tck0_trdcr1
tpsc1_trdcr1	.btequ		tck1_trdcr1
tpsc2_trdcr1	.btequ		tck2_trdcr1
;
;------------------------------------------------------
;  Timer RD I/O control register A1
;------------------------------------------------------
trdiora1		.equ		0151h
ioa0_trdiora1	.btequ		0,trdiora1	; TRDGRA control bit
ioa1_trdiora1	.btequ		1,trdiora1	; 
ioa2_trdiora1	.btequ		2,trdiora1	; TRDGRA mode selection bit
ioa3_trdiora1	.btequ		3,trdiora1	; Input capture input switch bit
iob0_trdiora1	.btequ		4,trdiora1	; TRDGRB control bit
iob1_trdiora1	.btequ		5,trdiora1	; 
iob2_trdiora1	.btequ		6,trdiora1	; TRDGRB mode selection bit
;
;------------------------------------------------------
;  Timer RD I/O control register C1
;------------------------------------------------------
trdiorc1		.equ		0152h
ioc0_trdiorc1	.btequ		0,trdiorc1	; TRDGRC control bit
ioc1_trdiorc1	.btequ		1,trdiorc1	; 
ioc2_trdiorc1	.btequ		2,trdiorc1	; TRDGRC mode selection bit
ioc3_trdiorc1	.btequ		3,trdiorc1	; TRDGRC register function selection bit
iod0_trdiorc1	.btequ		4,trdiorc1	; TRDGRD control bit
iod1_trdiorc1	.btequ		5,trdiorc1	; 
iod2_trdiorc1	.btequ		6,trdiorc1	; TRDGRD mode selection bit
iod3_trdiorc1	.btequ		7,trdiorc1	; TRDGRD register function selection bit
;
;------------------------------------------------------
;  Timer RD status register1
;------------------------------------------------------
trdsr1			.equ		0153h
imfa_trdsr1		.btequ		0,trdsr1	; Input capture / compare match flag A
imfb_trdsr1		.btequ		1,trdsr1	; Input capture / compare match flag B
imfc_trdsr1		.btequ		2,trdsr1	; Input capture / compare match flag C
imfd_trdsr1		.btequ		3,trdsr1	; Input capture / compare match flag D
ovf_trdsr1		.btequ		4,trdsr1	; Overflow flag
udf_trdsr1		.btequ		5,trdsr1	; Underflow flag
;
;------------------------------------------------------
;  Timer RD interruput enable register1
;------------------------------------------------------
trdier1			.equ		0154h
imiea_trdier1	.btequ		0,trdier1	; Input capture / compare match interrupt enable bit A
imieb_trdier1	.btequ		1,trdier1	; Input capture / compare match interrupt enable bit B
imiec_trdier1	.btequ		2,trdier1	; Input capture / compare match interrupt enable bit C
imied_trdier1	.btequ		3,trdier1	; Input capture / compare match interrupt enable bit D
ovie_trdier1	.btequ		4,trdier1	; Overflow / underflow interrupt enable bit
;
;------------------------------------------------------
;  Timer RD PWM mode output level control register1
;------------------------------------------------------
trdpocr1		.equ		0155h
polb_trdpocr1	.btequ		0,trdpocr1	; PWM mode output level control bit B
polc_trdpocr1	.btequ		1,trdpocr1	; PWM mode output level control bit C
pold_trdpocr1	.btequ		2,trdpocr1	; PWM mode output level control bit D
;
;------------------------------------------------------
;  Timer RD counter1
;------------------------------------------------------
trd1			.equ		0156h
;
;------------------------------------------------------
;  Timer RD general register A1
;------------------------------------------------------
trdgra1			.equ		0158h
;
;------------------------------------------------------
;  Timer RD general register B1
;------------------------------------------------------
trdgrb1			.equ		015ah
;
;------------------------------------------------------
;  Timer RD general register C1
;------------------------------------------------------
trdgrc1			.equ		015ch
;
;------------------------------------------------------
;  Timer RD general register D1
;------------------------------------------------------
trdgrd1			.equ		015eh
;
;------------------------------------------------------
;  Flash mamory control register4
;------------------------------------------------------
fmr4			.equ		01b3h
;
fmr40			.btequ		0,fmr4		; Erase-suspend function enable bit
fmr41			.btequ		1,fmr4		; Erase-suspend request bit
fmr42			.btequ		2,fmr4		; Program-suspend request bit
fmr43			.btequ		3,fmr4		; Erase command flag
fmr44			.btequ		4,fmr4		; Program command flag
fmr46			.btequ		6,fmr4		; Read status flag
fmr47			.btequ		7,fmr4		; Low-Power consumption read mode enable bit
;
;------------------------------------------------------
;  Flash mamory control register1
;------------------------------------------------------
fmr1			.equ		01b5h
;
fmr11			.btequ		1,fmr1		; EW1 mode select bit
fmr15			.btequ		5,fmr1		; Block0 rewrite disable bit
fmr16			.btequ		6,fmr1		; Block1 rewrite disable bit
;
;------------------------------------------------------
;  Flash mamory control register0
;------------------------------------------------------
fmr0			.equ		01b7h
;
fmr00			.btequ		0,fmr0		; RY/BY status flag
fmr01			.btequ		1,fmr0		; CPU rewrite mode select bit
fmr02			.btequ		2,fmr0		; Block0 and 1 rewrite enable bit
fmstp			.btequ		3,fmr0		; Flash memory stop bit
fmr06			.btequ		6,fmr0		; Program status flag
fmr07			.btequ		7,fmr0		; Erase status flag
;
